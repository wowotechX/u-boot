## arch/arm/mach-s5pc1xx/Kconfig
```kconfig
if ARCH_S5PC1XX

choice
	prompt "S5PC1XX board select"
	optional

config TARGET_S5P_GONI
	bool "S5P Goni board"
	select OF_CONTROL

config TARGET_SMDKC100
	bool "Support smdkc100 board"
	select OF_CONTROL

config TARGET_TINY210
	bool "Support Samsung Tiny210"
	select SUPPORT_SPL
	select SPL
		help
		Support Samsung Tiny210 platform based on Samsung s5pv210.


endchoice

config SYS_SOC
	default "s5pc1xx"

source "board/samsung/goni/Kconfig"
source "board/samsung/smdkc100/Kconfig"
source "board/samsung/tiny210/Kconfig"

endif
```

## board/actions/bubblegum/Kconfig
```kconfig
#
# (C) Copyright 2016 wowotech
#
# wowo<wowo@wowotech.net>
#
# SPDX-License-Identifier:	GPL-2.0+
#

if TARGET_BUBBLEGUM

config SYS_BOARD
	default "bubblegum"

config SYS_VENDOR
	default "actions"

config SYS_SOC
	default "s900"

config SYS_CONFIG_NAME
	default "bubblegum"

endif
```

## board/samsung/tiny210/Kconfig
```kconfig
#
# (C) Copyright 2016 ooonebook
#
# Project for Tiny210.
#
# ooonebook <ooonebook@163.com>
#
# SPDX-License-Identifier:  GPL-2.0+
#


if TARGET_TINY210

config SYS_BOARD
	default "tiny210"

config SYS_VENDOR
	default "samsung"

config SYS_SOC
	default "s5pc1xx"

config SYS_CONFIG_NAME
	default "tiny210"

config CLK_1000_200_166_133
	default 1

config EVT1
	default 1

config MCP_SINGLE
	default 1
endif
```

## configs/bubblegum_defconfig
```kconfig
CONFIG_ARM=y
CONFIG_TARGET_BUBBLEGUM=y
CONFIG_DEFAULT_DEVICE_TREE="s900-bubblegum"
CONFIG_FIT=y
CONFIG_SYS_PROMPT="[xprj]# "
# CONFIG_CMD_BOOTD is not set
# CONFIG_CMD_ELF is not set
# CONFIG_CMD_GO is not set
# CONFIG_CMD_RUN is not set
# CONFIG_CMD_IMI is not set
# CONFIG_CMD_IMLS is not set
# CONFIG_CMD_XIMG is not set
# CONFIG_CMD_EXPORTENV is not set
# CONFIG_CMD_IMPORTENV is not set
# CONFIG_CMD_EDITENV is not set
# CONFIG_CMD_SAVEENV is not set
# CONFIG_CMD_ENV_EXISTS is not set
CONFIG_LOOPW=y
CONFIG_CMD_MEMTEST=y
CONFIG_CMD_MX_CYCLIC=y
CONFIG_CMD_MEMINFO=y
# CONFIG_CMD_LOADS is not set
# CONFIG_CMD_FLASH is not set
# CONFIG_CMD_FPGA is not set
# CONFIG_CMD_ECHO is not set
# CONFIG_CMD_ITEST is not set
# CONFIG_CMD_SOURCE is not set
# CONFIG_CMD_SETEXPR is not set
# CONFIG_CMD_NET is not set
# CONFIG_CMD_NFS is not set
# CONFIG_CMD_MISC is not set
CONFIG_OF_CONTROL=y
CONFIG_DM=y
# CONFIG_DM_DEVICE_REMOVE is not set
CONFIG_PINCTRL=y
# CONFIG_PINCTRL_GENERIC is not set
CONFIG_OWL_PINCTRL=y
# CONFIG_SPL_SERIAL_PRESENT is not set
CONFIG_DM_SERIAL=y
CONFIG_OWL_SERIAL=y
CONFIG_REGEX=y
# CONFIG_EFI_LOADER is not set
```
