/*
* (C) Copyright 2016 wowotech
*
* Project for Tiny210.
*
* ooonebook <ooonebook@163.com>
*
* SPDX-License-Identifier:    GPL-2.0+
*/ 

/dts-v1/;
#include "skeleton.dtsi"
/{
	aliases {
		console = "/serial@e2900000";
	};

	serial@e2900000 {
		compatible = "samsung,exynos4210-uart";
		reg = <0xe2900000 0x100>;
		interrupts = <0 51 0>;
		id = <0>;
	};
};
